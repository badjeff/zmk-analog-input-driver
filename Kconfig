## Kconfig
```kconfig
# Sensor data simulator
#
# Copyright (c) 2019 Nordic Semiconductor
#
# SPDX-License-Identifier: LicenseRef-Nordic-5-Clause
#

menuconfig ANALOG_INPUT
	bool "ANALOG_INPUT adc sensor"
  select ADC
	help
	  Enable ANALOG_INPUT adc sensor.

if ANALOG_INPUT

config ANALOG_INPUT_USE_DTS_ADC_CH_CFG
		bool "Use per adc channel config from device tree"
		help
			Enable this to passthrow adc channel to chanel setup, 
			otherwise use default favor.
			(ADC_GAIN_1_6, ADC_REF_INTERNAL, ADC_ACQ_TIME_DEFAULT)

config ANALOG_INPUT_ADC_RES
		int "ADC Channels Resolution (Bit)"
		default 12
		help
			Resolution of ADC Channel. Default 12 bit, up to 32 bit.
			Used to setup buffer size of ADC sequencer of all channels.

config ANALOG_INPUT_WORKQUEUE_PRIORITY
    int "Workqueue priority"
    default 10
    help
      Priority of thread used by the workqueue

config ANALOG_INPUT_WORKQUEUE_STACK_SIZE
    int "Workqueue stack size"
    default 1024
    help
      Stack size of thread used by the workqueue

config ANALOG_INPUT_REPORT_INTERVAL_MIN
	int "ANALOG_INPUT's default minimum report rate"
	default 0
	help
	  Default minimum report interval in milliseconds.
		Slow down input reporting for hid queue over the air.

config ANALOG_INPUT_LOG_DBG_RAW
	bool "ANALOG_INPUT debug log for RAW mV"

config ANALOG_INPUT_LOG_DBG_REPORT
	bool "ANALOG_INPUT debug log for REPORT value"

module = ANALOG_INPUT
module-str = ANALOG_INPUT
source "${ZEPHYR_BASE}/subsys/logging/Kconfig.template.log_config"

endif #ANALOG_INPUT
```

## dts/bindings/zmk,analog-input.yaml
```yaml
# Copyright (c) 2022 The ZMK Contributors
# SPDX-License-Identifier: MIT
description: |
  Input driver for ADC io channel

compatible: "zmk,analog-input"

properties:
  sampling-hz:
    type: int
    default: 100

child-binding:
  description: Per-channel configuration settings
  properties:
    io-channels:
      type: phandle-array
      required: true
    mv-mid:
      type: int
      required: true
    mv-min-max:
      type: int
      required: true
    mv-deadzone:
      type: int
      default: 10
    invert:
      type: boolean
    report-on-change-only:
      type: boolean
    scale-multiplier:
      type: int
      default: 1
    scale-divisor:
      type: int
      default: 70
    evt-type:
      type: int
      required: true
    input-code:
      type: int
      required: true
```
